## drivers/virtio/Kconfig
```kconfig
# SPDX-License-Identifier: GPL-2.0-only
if VIRTIO_MENU

config VIRTIO_MEM
	tristate "Virtio mem driver"
	depends on X86_64 || ARM64 || RISCV
	depends on VIRTIO
	depends on MEMORY_HOTPLUG
	depends on MEMORY_HOTREMOVE
	depends on CONTIG_ALLOC
	depends on EXCLUSIVE_SYSTEM_RAM
	help
	 This driver provides access to virtio-mem paravirtualized memory
	 devices, allowing to hotplug and hotunplug memory.

	 This driver currently only supports x86-64 and arm64. Although it
	 should compile on other architectures that implement memory
	 hot(un)plug, architecture-specific and/or common
	 code changes may be required for virtio-mem, kdump and kexec to work as
	 expected.

	 If unsure, say M.

config VIRTIO_MMIO
	tristate "Platform bus driver for memory mapped virtio devices"
	depends on HAS_IOMEM && HAS_DMA
	select VIRTIO
	help
	 This drivers provides support for memory mapped virtio
	 platform device driver.

 	 If unsure, say N.

config VIRTIO_MMIO_SWIOTLB
	bool "Instantiate swiotlb buffer pool for custom DMA ops"
	depends on VIRTIO_MMIO
	help
	  Activating this feature results in custom DMA ops being
	  setup up for virtio_mmio device, that uses swiotlb driver
	  APIs to bounce buffers in and out of a pre-defined memory
	  region. The pre-defined memory region is defined in
	  device-tree (/swiotlb) and is indicative of memory that is
	  shared with another virtual machine which is hosting virtio
	  backend drivers.

config GH_VIRTIO_DEBUG
	bool "Enable debug features for virtio front-end drivers on Gunyah Hypervisor"
	depends on VIRTIO_MMIO
	help
	  Activating this feature provides additional tracepoints in various
	  virtio drivers that will be useful to debug virtio transactions.
	  Currently virtio block driver and mmio transport provide few
	  tracepoints when this feature is enabled.

endif # VIRTIO_MENU
```
