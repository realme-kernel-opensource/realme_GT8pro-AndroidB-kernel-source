## drivers/clk/qcom/Kconfig
```kconfig
# SPDX-License-Identifier: GPL-2.0-only
menuconfig COMMON_CLK_QCOM
	tristate "Support for Qualcomm's clock controllers"
	depends on OF
	depends on ARCH_QCOM || COMPILE_TEST
	select RATIONAL
	select REGMAP_MMIO
	select RESET_CONTROLLER
	select INTERCONNECT
	select INTERCONNECT_CLK

if COMMON_CLK_QCOM

config QCOM_CLK_RPMH
	tristate "RPMh Clock Driver"
	depends on QCOM_RPMH
	help
	 RPMh manages shared resources on some Qualcomm Technologies, Inc.
	 SoCs. It accepts requests from other hardware subsystems via RSC.
	 Say Y if you want to support the clocks exposed by RPMh on
	 platforms such as SDM845.

config SM_GCC_SUN
        tristate "SUN Global Clock Controller"
        help
	  Support for the global clock controller on Qualcomm Technologies, Inc
	  Sun devices.

config SM_GCC_PINEAPPLE
        tristate "Pineapple Global Clock Controller"
        help
          Support for the global clock controller on Qualcomm Technologies, Inc
          Pineapple devices.
          Say Y if you want to use peripheral devices such as UART,
          SPI, I2C, USB, SD/UFS, PCIe etc.

config SM_VIDEOCC_PINEAPPLE
	tristate "Pineapple Video Clock Controller"
	depends on SM_GCC_PINEAPPLE
	help
	  Support for the video clock controller on Qualcomm Technologies, Inc.
	  Pineapple devices.
	  Say Y if you want to support video devices and functionality such as
	  video encode/decode.

config SM_CAMCC_PINEAPPLE
	tristate "Pineapple Camera Clock Controller"
	depends on SM_GCC_PINEAPPLE
	help
	  Support for the camera clock controller on Qualcomm Technologies, Inc
	  Pineapple devices.
	  Say Y if you want to support camera devices and functionality such as
	  capturing pictures.

config SM_DISPCC_PINEAPPLE
	tristate "Pineapple Display Clock Controller"
	depends on SM_GCC_PINEAPPLE
	help
	  Support for the display clock controller on Qualcomm Technologies, Inc
	  Pineapple devices.
	  Say Y if you want to support display devices and functionality such as
	  splash screen.

config SM_GPUCC_PINEAPPLE
	tristate "Pineapple Graphics Clock Controller"
	depends on SM_GCC_PINEAPPLE
	help
	  Support for the graphics clock controller on Qualcomm Technologies, Inc
	  Pineapple devices.
	  Say Y if you want to support graphics controller devices and
	  functionality such as 3D graphics.

config SM_TCSRCC_PINEAPPLE
	tristate "Pineapple Top-Level CSR Clock Controller"
	depends on SM_GCC_PINEAPPLE
	help
	  Support for the TCSR clock controller on Qualcomm Technologies, Inc
	  Pineapple devices.
	  Say Y if you want to support miscellaneous top-level clocks
	  such as for the PHY references.

config SM_CAMCC_SUN
        tristate "SUN Camera Clock Controller"
        depends on SM_GCC_SUN
        help
          Support for the camera clock controller on Qualcomm Technologies, Inc
          Sun devices.
          Say Y if you want to support camera devices and functionality such as
          capturing pictures.

config SM_EVACC_SUN
	tristate "SUN EVA Clock Controller"
	depends on SM_GCC_SUN
	help
	  Support for the EVA clock controller on Qualcomm Technologies, Inc
	  Sun devices.
	  Say Y if you want to support EVA devices to get better
	  visual analysis.

config SM_GPUCC_SUN
	tristate "SUN Graphics Clock Controller"
        depends on SM_GCC_SUN
        help
	  Support for the graphics clock controller on Qualcomm Technologies, Inc
	  Sun devices.
	  Say Y if you want to support graphics controller devices and
	  functionality such as 3D graphics.

config SM_DISPCC_SUN
	tristate "SUN Display Clock Controller"
	depends on SM_GCC_SUN
	help
	  Support for the display clock controller on Qualcomm Technologies, Inc
	  Sun devices.
	  Say Y if you want to support display devices and functionality such as
	  splash screen.

config SM_CAMBISTMCLKCC_SUN
	tristate "SUN CAMBISTMCLK Clock Controller"
	depends on SM_GCC_SUN
	help
	  Support for the CAMBISTMCLK clock controller on Qualcomm Technologies,
	  Inc Sun devices.
	  Say Y if you want to support camera devices for a better low-latency
	  clock.

config SM_TCSRCC_SUN
	tristate "SUN Top-Level CSR Clock Controller"
	depends on SM_GCC_SUN
	help
	  Support for the TCSR clock controller on Qualcomm Technologies, Inc
	  Sun devices.
	  Say Y if you want to support miscellaneous top-level clocks
	  such as for the PHY references.

config SM_DEBUGCC_SUN
	tristate "Sun Debug Clock Controller"
	depends on COMMON_CLK_QCOM
	help
	  Support for the debug clock controller on Qualcomm Technologies, Inc
	  Sun devices.
	  Say Y if you want to support the debug clocks such as clock
	  measurement functionality.

config SM_EVACC_CANOE
	tristate "CANOE EVA Clock Controller"
	depends on SM_GCC_CANOE
	help
	  Support for the EVA clock controller on Qualcomm Technologies, Inc
	  CANOE devices.
	  Say Y if you want to support EVA devices to get better
	  visual analysis.

config SM_GCC_CANOE
        tristate "CANOE Global Clock Controller"
        help
	  Support for the global clock controller on Qualcomm Technologies, Inc
	  Canoe devices.
	  Say Y if you want to use peripheral devices such as UART,
	  SPI, I2C, USB, SD/UFS, PCIe etc.

config SM_DISPCC_CANOE
	tristate "CANOE Display Clock Controller"
	depends on SM_GCC_CANOE
	help
	  Support for the display clock controller on Qualcomm Technologies, Inc
	  Canoe devices.
	  Say Y if you want to support display devices and functionality such as
	  splash screen.

config SM_GPUCC_CANOE
	tristate "CANOE Graphics Clock Controller"
	depends on SM_GCC_CANOE
	help
	  Support for the graphics clock controller on Qualcomm Technologies, Inc
	  Canoe devices.
	  Say Y if you want to support graphics controller devices and
	  functionality such as 3D graphics.

config SM_CAMCC_CANOE
	tristate "CANOE Camera Clock Controller"
	depends on SM_GCC_CANOE
	help
	  Support for the camera clock controller on Qualcomm Technologies, Inc
	  Canoe devices.
	  Say Y if you want to support camera devices and functionality such as
	  capturing pictures.

config SM_CAMBISTMCLKCC_CANOE
	tristate "CANOE CAMBISTMCLK Clock Controller"
	depends on SM_GCC_CANOE
	help
	  Support for the CAMBISTMCLK clock controller on Qualcomm Technologies,
	  Inc Canoe devices.
	  Say Y if you want to support camera devices for a better low-latency
	  clock.

config SM_TCSRCC_CANOE
	tristate "CANOE Top-Level CSR Clock Controller"
	depends on SM_GCC_CANOE
	help
	  Support for the TCSR clock controller on Qualcomm Technologies, Inc
	  CANOE devices.
	  Say Y if you want to support miscellaneous top-level clocks
	  such as for the PHY references.

config SM_VIDEOCC_CANOE
	tristate "CANOE Video Clock Controller"
	depends on SM_GCC_CANOE
	help
	  Support for the video clock controller on Qualcomm Technologies, Inc
	  Canoe devices.
	  Say Y if you want to support video devices and functionality such as
	  video encode/decode.

config SM_DEBUGCC_CANOE
	tristate "CANOE Debug Clock Controller"
	depends on COMMON_CLK_QCOM
	help
	  Support for the debug clock controller on Qualcomm Technologies, Inc
	  CANOE devices.
	  Say Y if you want to support the debug clocks such as clock
	  measurement functionality.

config SM_GPUCC_6115
	tristate "SM6115 Graphics Clock Controller"
	select SM_GCC_6115
	depends on ARM64 || COMPILE_TEST
	help
	  Support for the graphics clock controller on SM6115 devices.
	  Say Y if you want to support graphics controller devices and
	  functionality such as 3D graphics.

config SM_GPUCC_6125
	tristate "SM6125 Graphics Clock Controller"
	select SM_GCC_6125
	depends on ARM64 || COMPILE_TEST
	help
	  Support for the graphics clock controller on SM6125 devices.
	  Say Y if you want to support graphics controller devices and
	  functionality such as 3D graphics.

config SM_GPUCC_6375
	tristate "SM6375 Graphics Clock Controller"
	select SM_GCC_6375
	depends on ARM64 || COMPILE_TEST
	help
	  Support for the graphics clock controller on SM6375 devices.
	  Say Y if you want to support graphics controller devices and
	  functionality such as 3D graphics.

config SM_GPUCC_6350
	tristate "SM6350 Graphics Clock Controller"
	depends on ARM64 || COMPILE_TEST
	select SM_GCC_6350
	help
	  Support for the graphics clock controller on SM6350 devices.
	  Say Y if you want to support graphics controller devices and
	  functionality such as 3D graphics.

config SM_GPUCC_8150
	tristate "SM8150 Graphics Clock Controller"
	depends on ARM64 || COMPILE_TEST
	select SM_GCC_8150
	help
	  Support for the graphics clock controller on SM8150 devices.
	  Say Y if you want to support graphics controller devices and
	  functionality such as 3D graphics.

config SM_GPUCC_8250
	tristate "SM8250 Graphics Clock Controller"
	depends on ARM64 || COMPILE_TEST
	select SM_GCC_8250
	help
	  Support for the graphics clock controller on SM8250 devices.
	  Say Y if you want to support graphics controller devices and
	  functionality such as 3D graphics.

config SM_GPUCC_8350
	tristate "SM8350 Graphics Clock Controller"
	depends on ARM64 || COMPILE_TEST
	select SM_GCC_8350
	help
	  Support for the graphics clock controller on SM8350 devices.
	  Say Y if you want to support graphics controller devices and
	  functionality such as 3D graphics.

config SM_GPUCC_8450
	tristate "SM8450 Graphics Clock Controller"
	depends on ARM64 || COMPILE_TEST
	select SM_GCC_8450
	help
	  Support for the graphics clock controller on SM8450 devices.
	  Say Y if you want to support graphics controller devices and
	  functionality such as 3D graphics.

config SM_GPUCC_8550
	tristate "SM8550 Graphics Clock Controller"
	depends on ARM64 || COMPILE_TEST
	select SM_GCC_8550
	help
	  Support for the graphics clock controller on SM8550 devices.
	  Say Y if you want to support graphics controller devices and
	  functionality such as 3D graphics.

config SM_GPUCC_8650
	tristate "SM8650 Graphics Clock Controller"
	depends on ARM64 || COMPILE_TEST
	select SM_GCC_8650
	help
	  Support for the graphics clock controller on SM8650 devices.
	  Say Y if you want to support graphics controller devices and
	  functionality such as 3D graphics.

config SM_TCSRCC_8550
	tristate "SM8550 TCSR Clock Controller"
	depends on ARM64 || COMPILE_TEST
	select QCOM_GDSC
	help
	  Support for the TCSR clock controller on SM8550 devices.
	  Say Y if you want to use peripheral devices such as SD/UFS.

config SM_TCSRCC_8650
	tristate "SM8650 TCSR Clock Controller"
	depends on ARM64 || COMPILE_TEST
	select QCOM_GDSC
	help
	  Support for the TCSR clock controller on SM8650 devices.
	  Say Y if you want to use peripheral devices such as SD/UFS.

config SM_VIDEOCC_7150
	tristate "SM7150 Video Clock Controller"
	depends on ARM64 || COMPILE_TEST
	select SM_GCC_7150
	select QCOM_GDSC
	help
	  Support for the video clock controller on SM7150 devices.
	  Say Y if you want to support video devices and functionality such as
	  video encode and decode.

config SM_VIDEOCC_8150
	tristate "SM8150 Video Clock Controller"
	depends on ARM64 || COMPILE_TEST
	select SM_GCC_8150
	select QCOM_GDSC
	help
	  Support for the video clock controller on SM8150 devices.
	  Say Y if you want to support video devices and functionality such as
	  video encode and decode.

config SM_VIDEOCC_8250
	tristate "SM8250 Video Clock Controller"
	depends on ARM64 || COMPILE_TEST
	select SM_GCC_8250
	select QCOM_GDSC
	help
	  Support for the video clock controller on SM8250 devices.
	  Say Y if you want to support video devices and functionality such as
	  video encode and decode.

config SM_VIDEOCC_8350
	tristate "SM8350 Video Clock Controller"
	depends on ARM64 || COMPILE_TEST
	select SM_GCC_8350
	select QCOM_GDSC
	help
	  Support for the video clock controller on SM8350 devices.
	  Say Y if you want to support video devices and functionality such as
	  video encode and decode.

config SM_VIDEOCC_8550
	tristate "SM8550 Video Clock Controller"
	depends on ARM64 || COMPILE_TEST
	select SM_GCC_8550
	select QCOM_GDSC
	help
	  Support for the video clock controller on Qualcomm Technologies, Inc.
	  SM8550 devices.
	  Say Y if you want to support video devices and functionality such as

config SM_VIDEOCC_SUN
	tristate "SUN Video Clock Controller"
	depends on SM_GCC_SUN
	help
	  Support for the video clock controller on Qualcomm Technologies, Inc
	  SUN devices.
	  Say Y if you want to support video devices and functionality such as
	  video encode/decode.

config QCOM_GDSC_REGULATOR
	tristate "GDSC regulator driver"
	depends on COMMON_CLK_QCOM
	help
	  This driver supports globally distributed switch controller (GDSC)
	  devices in regulator framework.
	  Say Y if you want to support clients using regulator framework APIs
	  to control GDSCs.

config SM_CAMCC_8150
	tristate "SM8150 Camera Clock Controller"
	select SM_GCC_8150
	help
	  Support for the camera clock controller on Qualcomm Technologies, Inc
	  SM8150 devices.
	  Say Y if you want to support camera devices and functionality such as
	  capturing pictures.

config SM_DEBUGCC_8150
	tristate "SM8150 Debug Clock Controller"
	depends on COMMON_CLK_QCOM
	help
	  Support for the debug clock controller on Qualcomm Technologies, Inc
	  SM8150 devices.
	  Say Y if you want to support the debug clocks such as
	  clock measurement functionality.

config SM_SCC_8150
	tristate "SM8150 Sensor Clock Controller"
	select SM_GCC_8150
	help
	  Support for the sensor clock controller on Qualcomm Technologies, Inc.
	  SM8150 devices.  The sensor controller contains several QUP clocks
	  which can be managed using DFS.  This controller is typically owned by
	  the sensor processor.  However, on some systems it is instead owned
	  by the application processor.

endif
```

## drivers/devfreq/Kconfig
```kconfig
# SPDX-License-Identifier: GPL-2.0-only
if PM_DEVFREQ

comment "DEVFREQ Governors"

config DEVFREQ_GOV_QCOM_ADRENO_TZ
	tristate "Qualcomm Technologies, Inc. GPU frequency governor"
	help
	  GPU frequency governor for the Adreno GPU. Sets the frequency
	  using an "on demand" algorithm in conjunction with other
	  components on Adreno platforms. This is not useful for non-Adreno
	  devices.

config DEVFREQ_GOV_QCOM_GPUBW_MON
	tristate "Qualcomm Technologies, Inc. GPU bandwidth governor"
	depends on DEVFREQ_GOV_QCOM_ADRENO_TZ
	help
	  This governor works together with the Adreno GPU governor to
	  select bus frequency votes using an "on-demand" algorithm.
	  This governor will not be useful for non-Adreno based
	  targets.

endif # PM_DEVFREQ
```

## drivers/i2c/busses/Kconfig
```kconfig
# SPDX-License-Identifier: GPL-2.0-only
#
# Sensor device configuration
#

menu "I2C Hardware Bus support"
	depends on HAS_IOMEM

comment "I2C system bus drivers (mostly embedded / system-on-chip)"

config I2C_MSM_GENI
	tristate "Qualcomm Technologies Inc.'s GENI based I2C controller"
	depends on ARCH_QCOM || COMPILE_TEST
	depends on QCOM_GENI_SE
	default n
	help
	  This driver supports GENI serial engine based I2C controller in
	  master mode on the Qualcomm Technologies Inc.'s SoCs. If you say
	  yes to this option, support will be included for the built-in I2C
	  interface on the Qualcomm Technologies Inc.'s SoCs.

	  This driver can also be built as a module.  If so, the module
	  will be called i2c-msm-geni.

endmenu
```
