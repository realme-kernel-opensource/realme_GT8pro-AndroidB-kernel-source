## drivers/iio/adc/Kconfig
```kconfig
# SPDX-License-Identifier: GPL-2.0-only
#
# ADC drivers
#
# When adding new entries keep the list in alphabetical order

menu "Analog to digital converters"

config QCOM_VADC_COMMON
	tristate

config QCOM_SPMI_RRADC
	tristate "Qualcomm SPMI RRADC"
	depends on MFD_SPMI_PMIC
	help
	  This is for the PMIC Round Robin ADC driver.

	  This driver exposes the battery ID resistor, battery thermal, PMIC die
	  temperature, charger USB in and DC in voltage and current.

	  To compile this driver as a module, choose M here: the module will
	  be called qcom-qpmi-rradc.

config QCOM_SPMI_ADC5_GEN3
	tristate "Qualcomm Technologies Inc. SPMI PMIC5 GEN3 ADC"
	depends on SPMI
	select REGMAP_SPMI
	select QCOM_VADC_COMMON
	help
	  This is the IIO Voltage PMIC5 Gen3 ADC driver for Qualcomm Technologies Inc.

	  The driver supports multiple channels read. The ADC is a 16-bit
	  sigma-delta ADC. The hardware supports calibrated results for
	  conversion requests and clients include reading voltage phone
	  power, on board system thermistors connected to the PMIC ADC,
	  PMIC die temperature, charger temperature, battery current, USB voltage
	  input, voltage signals connected to supported PMIC GPIO inputs. The
	  hardware supports internal pull-up for thermistors and can choose between
	  a 100k, 30k and 400k pull up using the ADC channels.

	  To compile this driver as a module, choose M here: the module will
	  be called qcom-spmi-adc5-gen3.

config QTI_GLINK_ADC
	tristate "Qualcomm Technologies Inc. PMIC Glink ADC"
	depends on QTI_PMIC_GLINK
	help
	  This is the IIO PMIC Glink ADC driver for Qualcomm Technologies, Inc.
	  PMICs.  It supports reading multiple ADC channels using the Glink
	  interface to communicate with charger firmware.  Channel value
	  conversion is performed in firmware.  Both converted and raw values
	  can be read.

endmenu
```

## drivers/leds/Kconfig
```kconfig
# SPDX-License-Identifier: GPL-2.0-only
# This library does not depend on NEW_LEDS and must be independent so it can be
# selected from other subsystems (specifically backlight).
if NEW_LEDS

comment "LED drivers"

config LEDS_QTI_FLASH
	tristate "Support for QTI Flash LEDs"
	depends on LEDS_CLASS_FLASH
	depends on MFD_SPMI_PMIC
	select LEDS_TRIGGERS
	help
	  This driver supports flash LED peripheral that is present on
	  some Qualcomm Technologies, Inc. PMICs (e.g. PM8350C).  It can
	  configure the flash LED target current for several independent
	  channels. It also supports various over current and over
	  temperature mitigation features.

	  To compile this driver as a module, choose M here: the
	  module will be called leds-qti-flash.

endif # NEW_LEDS
```

## drivers/misc/Kconfig
```kconfig
# SPDX-License-Identifier: GPL-2.0-only
#
# Misc strange devices
#

menu "Misc devices"

config QCOM_COINCELL
	tristate "Qualcomm coincell charger support"
	depends on MFD_SPMI_PMIC || COMPILE_TEST
	help
	  This driver supports the coincell block found inside of
	  Qualcomm PMICs.  The coincell charger provides a means to
	  charge a coincell battery or backup capacitor which is used
	  to maintain PMIC register and RTC state in the absence of
	  external power.

config QSEECOM_PROXY
	tristate "To enable qseecom proxy driver for kernel client"
	help
	 qseecom proxy driver serves the kernel clients by providing
	 required ops via call back functions with a minimal framework.
	 These callback functions can be used to start, shutdown and
	 send commands to the trusted apps.

endmenu
```

## drivers/mmc/host/Kconfig
```kconfig
# SPDX-License-Identifier: GPL-2.0-only
#
# MMC/SD host controller drivers
#

comment "MMC/SD/SDIO Host Controller Drivers"

config MMC_SDHCI_MSM
	tristate "Qualcomm SDHCI Controller Support"
	depends on ARCH_QCOM || COMPILE_TEST
	depends on MMC_SDHCI_PLTFM
	select MMC_SDHCI_IO_ACCESSORS
	select MMC_CQHCI
	select QCOM_INLINE_CRYPTO_ENGINE if MMC_CRYPTO
	help
	  This selects the Secure Digital Host Controller Interface (SDHCI)
	  support present in Qualcomm SOCs. The controller supports
	  SD/MMC/SDIO devices.

	  If you have a controller with this interface, say Y or M here.

	  If unsure, say N.

config SDHCI_MSM_DBG
	bool "Qualcomm Technologies, Inc. SDHCI_MSM_DBG Driver"
	depends on MMC_SDHCI_MSM
	help
	  This enables the IPC tracing events for sdhci_msm driver.

	  Tracing sdhci_msm events helps to trace significant events
	  used for debugging purpose.

	  If unsure, say N here.
```

## drivers/net/Kconfig
```kconfig
# SPDX-License-Identifier: GPL-2.0-only
#
# Network device configuration
#

config VIRTIO_NET
	tristate "Virtio network driver"
	depends on VIRTIO
	select NET_FAILOVER
	select DIMLIB
	help
	  Enable this option to include the VirtIO-based network driver.
	  This driver is essential for supporting VirtIO network devices,
	  commonly used in virtualization environments. It works with
	  QEMU-based virtual machine managers (e.g., KVM or Xen).
	  Say Y or M.
```

## drivers/pci/controller/Kconfig
```kconfig
# SPDX-License-Identifier: GPL-2.0

menu "PCI controller drivers"
	depends on PCI

config PCI_MSM
	tristate "MSM PCIe Controller driver"
	depends on ARCH_QCOM && PCI
	depends on PCI_DOMAINS
	depends on PCI_DOMAINS_GENERIC
	depends on PCI_MSI
	depends on CRC8
	help
	  Enables the PCIe functionality by configuring PCIe core on
	  MSM chipset and by enabling the ARM PCI framework extension.
	  The PCIe core is essential for communication between the host
	  and an endpoint.

	  If unsure, say N.

endmenu
```

## drivers/perf/Kconfig
```kconfig
# SPDX-License-Identifier: GPL-2.0-only
#
# Performance Monitor Drivers
#

menu "Performance monitor support"
	depends on PERF_EVENTS

config QCOM_LLCC_PMU
	tristate "Qualcomm Technologies LLCC PMU"
	depends on ARCH_QCOM && ARM64
	help
	   Provides support for the LLCC performance monitor unit (PMU) in
	   Qualcomm Technologies processors.
	   Adds the LLCC PMU into the perf events subsystem for monitoring
	   LLCC miss events.

endmenu
```

## drivers/phy/qualcomm/Kconfig
```kconfig
# SPDX-License-Identifier: GPL-2.0-only
#
# Phy drivers for Qualcomm and Atheros platforms
#

config PHY_QCOM_UFS
	tristate "Qualcomm Technologies, Inc. UFS PHY driver"
	depends on OF && ARCH_QCOM
	select GENERIC_PHY
	help
	  Enables support for UFS PHY on Qualcomm Technologies, Inc.
	  chipsets.
	  This driver together with the UFS PHY controller specific
	  driver enables the UFS PHY support for Qualcomm Technologies, Inc.
	  chips.

if PHY_QCOM_UFS

config PHY_QCOM_UFS_V4
	tristate "Qualcomm Technologies, Inc. UFS V4"
	depends on PHY_QCOM_UFS
	help
	  Support for 7nm UFS QMP phy present on QCOM chipsets.
	  This is required to enable UFS on QCOM chipset.
	  To compile this driver as a module, choose M here.

config PHY_QCOM_UFS_V4_GEN3AUTO
	tristate "Qualcomm Technologies, Inc. UFS gen3auto Phy Driver"
	depends on PHY_QCOM_UFS
	help
	  Support for 7nm UFS QMP phy present on QCOM chipsets.
	  This is required to enable UFS on QCOM chipset.
	  To compile this driver as a module, choose M here.

config PHY_QCOM_UFS_QRBTC_SDM845
	tristate "Qualcomm Technologies, Inc. UFS Presil Phy Driver"
	depends on PHY_QCOM_UFS && REGULATOR_STUB
	help
	  Enable this to support UFS PHY on pre-silicon platforms.
	  The support is restricted to HS-G1 only on both Tx and Rx.
	  No low power mode support is present.
	  Doesn't restrict number of lanes.

config PHY_QCOM_UFS_V4_SUN
	tristate "Qualcomm Technologies, Inc. UFS Sun Phy Driver"
	depends on PHY_QCOM_UFS
	help
	  Support for UFS phy present on QCOM Sun chipsets.
	  This is required to enable UFS on Sun chipset.
	  To compile this driver as a module, choose M here.

config PHY_QCOM_UFS_V4_CANOE
	tristate "Qualcomm Technologies, Inc. UFS Canoe Phy Driver"
	depends on PHY_QCOM_UFS
	help
	  This configuration option adds support for the UFS
	  PHY present on QCOM Canoe chipsets.
	  This is required to enable UFS on Canoe chipset.
	  To compile this driver as a module, choose M here.
	  This is good debug.

endif
```

## drivers/pinctrl/qcom/Kconfig
```kconfig
# SPDX-License-Identifier: GPL-2.0-only
if (ARCH_QCOM || COMPILE_TEST)

config PINCTRL_MSM
	tristate "Qualcomm core pin controller driver"
	depends on GPIOLIB
	# OF for pinconf_generic_dt_node_to_map_group() from GENERIC_PINCONF
	depends on OF
	select QCOM_SCM
	select PINMUX
	select PINCONF
	select GENERIC_PINCONF
	select GPIOLIB_IRQCHIP
	select IRQ_DOMAIN_HIERARCHY
	select IRQ_FASTEOI_HIERARCHY_HANDLERS

source "$(KCONFIG_EXT_PREFIX)drivers/pinctrl/qcom/Kconfig.msm"

endif
```

## drivers/pinctrl/qcom/Kconfig.msm
```kconfig
# SPDX-License-Identifier: GPL-2.0-only
if PINCTRL_MSM

config PINCTRL_CANOE
	tristate "Qualcomm Technologies, Inc. CANOE pin controller driver"
	depends on GPIOLIB && OF
	help
	  This is the pinctrl, pinmux, pinconf and gpiolib driver for the
	  Qualcomm Technologies Inc Top Level Mode Multiplexer block (TLMM)
	  block found on the Qualcomm Technologies Inc CANOE platform.
	  Say Y here to compile statically, or M here to compile it as a
	  module. If unsure, say N.

config PINCTRL_SUN
	tristate "Qualcomm Technologies, Inc. SUN pin controller driver"
	depends on GPIOLIB && OF
	help
	  This is the pinctrl, pinmux, pinconf and gpiolib driver for the
	  Qualcomm Technologies Inc Top Level Mode Multiplexer block (TLMM)
	  block found on the Qualcomm Technologies Inc SUN platform.
	  Say Y here to compile statically, or M here to compile it as a
	  module. If unsure, say N.

config PINCTRL_VIENNA
	tristate "Qualcomm Technologies, Inc. VIENNA pin controller driver"
	depends on GPIOLIB && OF
	help
	  This is the pinctrl, pinmux, pinconf and gpiolib driver for the
	  Qualcomm Technologies Inc Top Level Mode Multiplexer block (TLMM)
	  block found on the Qualcomm Technologies Inc VIENNA platform.
	  Say Y here to compile statically, or M here to compile it as a
	  module. If unsure, say N.

config PINCTRL_PINEAPPLE
	tristate "Qualcomm Technologies, Inc. Pineapple pin controller driver"
	depends on GPIOLIB && OF
	help
	  This is the pinctrl, pinmux, pinconf and gpiolib driver for the
	  Qualcomm Technologies Inc Top Level Mode Multiplexer block (TLMM)
	  block found on the Qualcomm Technologies Inc PINEAPPLE platform.
	  Say Y here to compile statically, or M here to compile it as a
	  module. If unsure, say N.

endif
```

## drivers/powercap/qcom/Kconfig
```kconfig
# SPDX-License-Identifier: GPL-2.0-only
config QCOM_POWER_TELEMETRY_FRAMEWORK
	tristate "Qualcomm Technologies, Inc. Power Telemetry Hardware Framework"
	depends on POWERCAP
	help
	  This enables Qualcomm Technologies, Inc. power telemetry framework.
	  It provides a framework support to register for different power
	  capable device channels. Based on devicetree power-zones hierarchy,
	  it binds different channels to power-zone node (aka qptm). Each
	  qptm node registers with powercap framework as powercap zones.

config QCOM_POWER_TELEMETRY_HW
	tristate "Qualcomm Technologies, Inc. Power Telemetry Hardware driver"
	depends on NVMEM_SPMI_SDAM
	depends on QCOM_POWER_TELEMETRY_FRAMEWORK
	help
	  This enables Qualcomm Technologies, Inc. power telemetry
	  hardware device driver. It provides power and energy data for different
	  power devices like pmic regulator, bobs etc. It registers each power/energy
	  channel to power telemetry framework.
```

## drivers/regulator/Kconfig
```kconfig
# SPDX-License-Identifier: GPL-2.0-only
if REGULATOR

config REGULATOR_DEBUG_CONTROL
	tristate "Regulator debug control support"
	depends on DEBUG_FS
	help
	  This driver supports debugfs based control of regulators for testing
	  purposes.  It provides a mechanism to vote on the enable state,
	  voltage, mode, and load current of regulators that make use of its
	  interface.  It also extends the monitoring interface for regulators.

config REGULATOR_QTI_FIXED_VOLTAGE
	tristate "QTI fixed voltage regulator support"
	help
	  This driver provides support for fixed voltage regulators which are
	  controlled via a GPIO.  It also supports proxy consumer voting and
	  debug features utilized on Qualcomm Technologies, Inc. boards.  Use
	  this driver in place of the fixed voltage regulator driver if these
	  additional features are required.

config REGULATOR_PROXY_CONSUMER
	tristate "Boot time regulator proxy consumer support"
	help
	  This library provides support for boot time regulator proxy requests.
	  It can enforce a specified voltage range, set a minimum current,
	  and/or keep a regulator enabled.  It is needed in circumstances where
	  reducing one or more of these three quantities will cause hardware to
	  stop working if performed before the driver managing the hardware has
	  probed.

config REGULATOR_PROXY_CONSUMER_LEGACY
	bool "Legacy proxy consumer unvoting support"
	depends on REGULATOR_PROXY_CONSUMER
	help
	  By default, the proxy consumer library unvotes the proxy requests made
	  for a given device when the sync_state() callback of the device is
	  called after all of its consumers have probed.  When this legacy
	  unvoting feature is enabled, unvoting happens unconditionally at
	  late_initcall_sync() instead of per-device via sync_state()
	  callback calls.

config REGULATOR_QCOM_RPMH
	tristate "Qualcomm Technologies, Inc. RPMh regulator driver"
	depends on QCOM_RPMH || (QCOM_RPMH=n && COMPILE_TEST)
	depends on QCOM_COMMAND_DB || (QCOM_COMMAND_DB=n && COMPILE_TEST)
	help
	  This driver supports control of PMIC regulators via the RPMh hardware
	  block found on Qualcomm Technologies Inc. SoCs.  RPMh regulator
	  control allows for voting on regulator state between multiple
	  processors within the SoC.

config REGULATOR_QCOM_AMOLED
	tristate "Qualcomm Technologies, Inc. AMOLED support"
	depends on SPMI
	help
	  Supports the OLEDB/AB/IBB module in the Qualcomm Technologies, Inc.
	  PMICs. Exposes regulators to control the triple power supply
	  positive, negative and bias for the AMOLED display panel. It also
	  allows configurability for the various bias-voltage parameters.

config REGULATOR_RPMH
	tristate "Qualcomm Technologies, Inc. Legacy RPMh regulator driver"
	depends on QCOM_RPMH
	help
	  This driver supports control of PMIC regulators via the RPMh hardware
	  block found on Qualcomm Technologies Inc. SoCs.  RPMh regulator
	  control allows for voting on regulator state between multiple
	  processors within the SoC.

config REGULATOR_STUB
	tristate "Stub Regulator"
	help
	  This driver adds stub regulator support. It allows for consumers to
	  request their regulator devices and to use all of the standard
	  regulator functions. It is useful for bringing up new platforms when
	  the real hardware based regulator implementation is not yet available.
	  Consumers can use stub regulator device with proper constraint
	  checking while the real regulator driver is being developed.

config REGULATOR_QTI_OCP_NOTIFIER
	tristate "Qualcomm Technologies, Inc. Regulator OCP Notifier Driver"
	help
	  This driver provides support for logging and notifying consumers about
	  regulator over-current (OCP) events on certain Qualcomm Technologies,
	  Inc. PMIC devices.  This is useful for debugging as well as for
	  providing a more graceful recovery mechanism than resetting the entire
	  system.

endif
```

## drivers/tty/serial/Kconfig
```kconfig
# SPDX-License-Identifier: GPL-2.0
#
# Serial device configuration
#

menu "Serial drivers"
	depends on HAS_IOMEM

comment "Non-8250 serial port support"

config SERIAL_MSM_GENI
    tristate "MSM on-chip GENI HW based serial port support"
    depends on ARCH_QCOM
    depends on QCOM_GENI_SE

endmenu
```
